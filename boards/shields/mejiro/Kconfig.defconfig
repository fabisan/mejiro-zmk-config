## boards/shields/mejiro/Kconfig.defconfig
```kconfig
if SHIELD_MEJIRO_LEFT

# Name must be less than 16 characters long!
config ZMK_KEYBOARD_NAME
    default "mejiro"

config ZMK_SPLIT_ROLE_CENTRAL
    default y

endif

if SHIELD_MEJIRO_LEFT || SHIELD_MEJIRO_RIGHT

config ZMK_SPLIT
    default y

endif
```

## boards/shields/mejiro/Kconfig.shield
```kconfig
# No whitespace after the comma or in your part name!
config SHIELD_MEJIRO_LEFT
    def_bool $(shields_list_contains,mejiro_left)

# No whitespace after the comma or in your part name!
config SHIELD_MEJIRO_RIGHT
    def_bool $(shields_list_contains,mejiro_right)
```
